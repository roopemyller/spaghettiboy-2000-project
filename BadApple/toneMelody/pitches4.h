#include <avr/pgmspace.h>

int tonePin = 8;
int dur = 77;
int longDur = 153;
int delayTime = 85;

// Note table indices:
// 0: 277 Hz
// 1: 293 Hz  
// 2: 311 Hz
// 3: 349 Hz
// 4: 369 Hz
// 5: 415 Hz
// 6: 466 Hz
// 7: 554 Hz
// 8: 622 Hz
// 9: 698 Hz
// 10: 739 Hz
// 11: 155 Hz (special low note)
// 12: 123 Hz (special low note)
// 13: 138 Hz (special low note)
// 14: 184 Hz (special low note)
// 15: 207 Hz (special low note)
// 16: 233 Hz (special low note)
// 17: DELAY marker
// For long notes: add 18 to the index

const uint16_t noteTable[] PROGMEM = {
  277, 293, 311, 349, 369, 415, 466, 554, 622, 698, 739, 155, 123, 138, 184, 207, 233, 0  // 17 = delay (0 frequency)
};

// RLE Packed format: {note_index, repeat_count}
// note_index 0-16 = normal notes
// note_index 17 = delay
// note_index 18-35 = long notes (add 18 to base index for long version)
const uint8_t rle_packed[] PROGMEM = {
  // First section - Main melody pattern
  2, 2,    // 311 x2
  3, 1,    // 349 x1
  5, 2,    // 415 x2
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  6, 1,    // 466 x1
  
  // Section with long notes (add 18 to index for long duration)
  24, 2,   // Long 311 x2 (18+2=24)
  24, 1,   // Long 311 x1
  25, 2,   // Long 349 x2
  24, 2,   // Long 311 x2
  26, 2,   // Long 369 x2
  27, 2,   // Long 415 x2
  28, 2,   // Long 466 x2
  24, 2,   // Long 311 x2
  17, 2,   // delay x2
  
  // Section with special low notes
  11, 1,   // 155 Hz
  12, 1,   // 123 Hz
  7, 2,    // 554 x2
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  4, 1,    // 369 x1
  
  // Final section repeats earlier patterns
  2, 2,    // 311 x2
  3, 2,    // 349 x2
  4, 2,    // 369 x2
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  0, 0    // End marker
};

void midi() {
  int index = 0;
  
  while (true) {
    uint8_t noteIdx = pgm_read_byte(&rle_packed[index]);
    uint8_t count = pgm_read_byte(&rle_packed[index + 1]);
    
    if (noteIdx == 0 && count == 0) break;  // End marker
    
    boolean isLong = (noteIdx >= 18);
    uint8_t baseIdx = isLong ? noteIdx - 18 : noteIdx;
    
    for (int j = 0; j < count; j++) {
      if (baseIdx == 17) {  // Delay
        delay(delayTime);
      } else {
        uint16_t freq = pgm_read_word(&noteTable[baseIdx]);
        if (isLong) {
          tone(tonePin, freq, longDur);
        } else {
          tone(tonePin, freq, dur);
        }
        delay(delayTime);
      }
    }
    
    index += 2;
  }
}